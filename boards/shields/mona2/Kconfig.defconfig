## boards/shields/mona2/Kconfig.defconfig
```kconfig
if SHIELD_MONA2_R

config ZMK_KEYBOARD_NAME
    default "mona2"

config ZMK_BLE
    default y

config ZMK_SPLIT_ROLE_CENTRAL
    default y

config INPUT
    default y

config ZMK_POINTING
    default y

config SPI
    default y

config PMW3610
    default y

# PMW3610設定のデフォルト値を定義(警告回避)
if PMW3610

config PMW3610_REPORT_INTERVAL_MIN
    int
    default 8

config PMW3610_RUN_DOWNSHIFT_TIME_MS
    int
    default 5000

config PMW3610_REST1_SAMPLE_TIME_MS
    int
    default 40

config PMW3610_REST1_DOWNSHIFT_TIME_MS
    int
    default 10000

endif # PMW3610

endif

if SHIELD_MONA2_R || SHIELD_MONA2_L

config NFCT_PINS_AS_GPIOS
    default y

config ZMK_SPLIT
    default y

config RGBLED_WIDGET_BATTERY_LEVEL_HIGH
    default 30

config RGBLED_WIDGET_BATTERY_LEVEL_CRITICAL
    default 10

endif
```
